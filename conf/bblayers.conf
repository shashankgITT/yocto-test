## conf/bblayers.conf
```bitbake
LCONF_VERSION = "7"

BBPATH   = "${TOPDIR}"
BSPDIR  := "${@os.path.abspath(os.path.dirname(d.getVar('FILE', True)) + '/..')}"

BBFILES ?= ""
BBLAYERS = "\
	${BSPDIR}/yocto/meta \
	${BSPDIR}/yocto/meta-poky \
	\
	${BSPDIR}/meta-openembedded/meta-oe \
	${BSPDIR}/meta-openembedded/meta-multimedia \
	${BSPDIR}/meta-openembedded/meta-networking \
	${BSPDIR}/meta-openembedded/meta-python \
	${BSPDIR}/meta-openembedded/meta-gnome \
	${BSPDIR}/meta-openembedded/meta-webserver \
	\
	${BSPDIR}/meta-st-openstlinux \
	${BSPDIR}/meta-st-stm32mp \
	${BSPDIR}/meta-qt5 \
	\
	${BSPDIR}/meta-mender/meta-mender-core \
	\
	${BSPDIR}/meta-rogue \
"
```
